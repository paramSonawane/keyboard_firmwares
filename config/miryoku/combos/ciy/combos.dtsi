#include "../constants.h"
#include "../macros.dtsi"
#include "switches.h"
#include "../common/combos.dtsi"


/ {
    combos {
        compatible = "zmk,combos";


// ┌───┬───┬───┬───┬───┬───╥───┬───┬───┬───┬───┬───┬───┬───────┬───┐
// │   │   │   │   │   │   ║   │   │   │   │   │   │   │       │   │
// ├───┴─┬─┴─┬─┴─┬─┴─┬─┴─┬─╨─╥─┴─┬─┴─┬─┴─┬─┴─┬─┴─┬─┴─┬─┴─┬─────┼───┤
// │     │   │   │   │   │   ║   │   │   │   │   │   │   │     │   │
// ├─────┴┬──┴┬──┴┬──┴┬──┴┬──╨╥──┴┬──┴┬──┴┬──┴┬──┴┬──┴┬──┴─────┼───┤
// │      │   │   │   │   │   ║   │   │   │   │   │   │        │   │
// ├──────┴─┬─┴─┬─┴─┬─┴─┬─┴─┬─╨─╥─┴─┬─┴─┬─┴─┬─┴─┬─┴─┬─┴────┬───┼───┤
// │        │   │   │   │   │   ║   │   │   │   │   │      │   │   │
// ├────┬───┴┬──┴─┬─┴───┴───┴───╨───┴───┴──┬┴──┬┴──┬┴──┬───┼───┼───┤
// │    │    │    │                        │ FN│   │   │   │   │BSE│
// └────┴────┴────┴────────────────────────┴───┴───┴───┴───┴───┴───┘
        // from game layer to base layer
        QUICK_COMBO(U_SYM, FN_KEY, BOTTOM_RIGHT_CORNER, &to U_BASE)
    };
};
