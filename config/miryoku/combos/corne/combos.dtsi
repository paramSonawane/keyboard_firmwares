#include "../constants.h"
#include "../macros.dtsi"
#include "switches.h"
#include "../common/combos.dtsi"


/ {
    combos {
        compatible = "zmk,combos";

// ┌───┬───┬───┬───┬───┬───┐           ┌───┬───┬───┬───┬───┬───┐
// │   │   │   │   │   │   │           │   │   │   │   │   │   │
// ├───┼───┼───┼───┼───┼───┤           ├───┼───┼───┼───┼───┼───┤
// │   │   │   │   │   │   │           │   │   │   │   │   │   │
// ├───┼───┼───┼───┼───┼───┤           ├───┼───┼───┼───┼───┼───┤
// │   │   │   │   │   │   │           │   │   │   │   │   │   │
// └───┴───┴───┴──┬┴──┬┴──┬┴───┐   ┌───┴┬──┴┬──┴┬──┴───┴───┴───┘
//                │   │   │ ENT│   │ER  │   │   │
//                └───┴───┴────┘   └────┴───┴───┘
        // TODO: disable wait time
        // enter
        QUICK_COMBO(U_BASE, RIGHT_THUMB_OUTER, LEFT_THUMB_OUTER, &kp RET)
    };
};
