#include "../../../miryoku_behaviors/combos/constants.h"
#include "../../../miryoku_behaviors/combos/macros.dtsi"
#include "../../../miryoku_behaviors/combos/switches.h"


/ {
    combos {

        compatible = "zmk,combos";

        // caps lock
        COMBO(U_BASE, MIDDLE_LEFTINDEX, MIDDLE_RIGHTINDEX, &caps_word)

        // -
        COMBO(U_BASE, TOP_RIGHTRING, RIGHT_THUMB_OUTER, &kp MINUS)

        // =
        COMBO(U_BASE, MIDDLE_RIGHTRING, RIGHT_THUMB_OUTER, &kp EQUAL)

       // _
       COMBO(U_BASE, BOTTOM_RIGHTRING, RIGHT_THUMB_OUTER, &kp UNDER)

        // [
        COMBO(U_BASE, TOP_RIGHTINDEX, RIGHT_THUMB_OUTER, &kp RBKT)

        // }
        COMBO(U_BASE, MIDDLE_RIGHTINDEX, RIGHT_THUMB_OUTER, &kp RBRC)

        // )
        COMBO(U_BASE, BOTTOM_RIGHTINDEX, RIGHT_THUMB_OUTER, &kp RPAR)

        // '
        COMBO(U_BASE, TOP_RIGHTMIDDLE, RIGHT_THUMB_OUTER, &kp SQT)

        // "
        COMBO(U_BASE, MIDDLE_RIGHTMIDDLE, RIGHT_THUMB_OUTER, &kp DQT)

        // `
        COMBO(U_BASE, BOTTOM_RIGHTINDEX, RIGHT_THUMB_OUTER, &kp GRAVE)

        // [
        COMBO(U_BASE, TOP_LEFTINDEX, LEFT_THUMB_OUTER, &kp LBKT)

        // {
        COMBO(U_BASE, MIDDLE_LEFTINDEX, LEFT_THUMB_OUTER, &kp LBRC)

        // (
        COMBO(U_BASE, BOTTOM_LEFTINDEX, LEFT_THUMB_OUTER, &kp LPAR)

        // escape
        COMBO(U_BASE, MIDDLE_LEFTMIDDLE, LEFT_THUMB_OUTER, &kp ESC)

        // tab
        COMBO(U_BASE, MIDDLE_LEFTRING, LEFT_THUMB_OUTER, &kp TAB)

        // del
        COMBO(U_BASE, BOTTOM_LEFTMIDDLE, LEFT_THUMB_OUTER, &kp DEL)

        // TODO: disable wait time
        // enter
        COMBO(U_BASE, BOTTOM_LEFTMIDDLE, LEFT_THUMB_OUTER, &kp RET)
    };
};
